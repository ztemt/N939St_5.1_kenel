/* Copyright (c) 2014, The Linux Foundation. All rights reserved.
 *
 * This program is free software; you can redistribute it and/or modify
 * it under the terms of the GNU General Public License version 2 and
 * only version 2 as published by the Free Software Foundation.
 *
 * This program is distributed in the hope that it will be useful,
 * but WITHOUT ANY WARRANTY; without even the implied warranty of
 * MERCHANTABILITY or FITNESS FOR A PARTICULAR PURPOSE.  See the
 * GNU General Public License for more details.
 */

/*---------------------------------------------------------------------------
 * This file is autogenerated file using gcdb parser. Please do not edit it.
 * Update input XML file to add a new entry or update variable in this file
 * VERSION = "1.0"
 *---------------------------------------------------------------------------*/
&mdss_mdp {
	dsi_rm68200_720_vid: qcom,mdss_dsi_rm68200_720p_video {
		qcom,mdss-dsi-panel-name = "rm68200 720p video mode dsi panel";
		qcom,mdss-dsi-panel-controller = <&mdss_dsi0>;
		qcom,mdss-dsi-panel-type = "dsi_video_mode";
		qcom,mdss-dsi-panel-destination = "display_1";
		qcom,mdss-dsi-panel-framerate = <60>;
		qcom,mdss-dsi-virtual-channel-id = <0>;
		qcom,mdss-dsi-stream = <0>;
		qcom,mdss-dsi-panel-width = <720>;
		qcom,mdss-dsi-panel-height = <1280>;
		qcom,mdss-dsi-h-front-porch = <26>;
		qcom,mdss-dsi-h-back-porch = <36>;
		qcom,mdss-dsi-h-pulse-width = <2>;
		qcom,mdss-dsi-h-sync-skew = <0>;
		qcom,mdss-dsi-v-back-porch = <16>;
		qcom,mdss-dsi-v-front-porch = <16>;
		qcom,mdss-dsi-v-pulse-width = <4>;
		qcom,mdss-dsi-h-left-border = <0>;
		qcom,mdss-dsi-h-right-border = <0>;
		qcom,mdss-dsi-v-top-border = <0>;
		qcom,mdss-dsi-v-bottom-border = <0>;
		qcom,mdss-dsi-bpp = <24>;
		qcom,mdss-dsi-underflow-color = <0xff>;
		qcom,mdss-dsi-border-color = <0>;
		qcom,mdss-dsi-on-command = [39 01 00 00 00 00 02 FE 01
									39 01 00 00 00 00 02 00 0A
									39 01 00 00 00 00 02 24 C0
									39 01 00 00 00 00 02 25 53
									39 01 00 00 00 00 02 26 00
									39 01 00 00 00 00 02 27 0A
									39 01 00 00 00 00 02 29 0A
									39 01 00 00 00 00 02 2B E5
									39 01 00 00 00 00 02 16 52
									39 01 00 00 00 00 02 2F 54
									39 01 00 00 00 00 02 34 55
									39 01 00 00 00 00 02 1B 00
									39 01 00 00 00 00 02 12 08
									39 01 00 00 00 00 02 1A 06
									39 01 00 00 00 00 02 52 70
									39 01 00 00 00 00 02 53 00
									39 01 00 00 00 00 02 54 70
									39 01 00 00 00 00 02 55 00
									39 01 00 00 00 00 02 FE 03
									39 01 00 00 00 00 02 01 14
									39 01 00 00 00 00 02 02 01
									39 01 00 00 00 00 02 03 00
									39 01 00 00 00 00 02 04 00
									39 01 00 00 00 00 02 05 00
									39 01 00 00 00 00 02 06 00
									39 01 00 00 00 00 02 07 05
									39 01 00 00 00 00 02 08 14
									39 01 00 00 00 00 02 09 06
									39 01 00 00 00 00 02 0A 00
									39 01 00 00 00 00 02 0B 00
									39 01 00 00 00 00 02 0C 00
									39 01 00 00 00 00 02 0D 00
									39 01 00 00 00 00 02 0E 0A
									39 01 00 00 00 00 02 0F 0B
									39 01 00 00 00 00 02 10 0C
									39 01 00 00 00 00 02 11 0D
									39 01 00 00 00 00 02 12 00
									39 01 00 00 00 00 02 13 7D
									39 01 00 00 00 00 02 14 00
									39 01 00 00 00 00 02 15 C5
									39 01 00 00 00 00 02 16 08
									39 01 00 00 00 00 02 17 0E
									39 01 00 00 00 00 02 18 0F
									39 01 00 00 00 00 02 19 10
									39 01 00 00 00 00 02 1A 11
									39 01 00 00 00 00 02 1B 00
									39 01 00 00 00 00 02 1C 7D
									39 01 00 00 00 00 02 1D 00
									39 01 00 00 00 00 02 1E 85
									39 01 00 00 00 00 02 1F 08
									39 01 00 00 00 00 02 20 00
									39 01 00 00 00 00 02 21 00
									39 01 00 00 00 00 02 22 0A
									39 01 00 00 00 00 02 23 10
									39 01 00 00 00 00 02 24 12
									39 01 00 00 00 00 02 25 2D
									39 01 00 00 00 00 02 26 00
									39 01 00 00 00 00 02 27 14
									39 01 00 00 00 00 02 28 16
									39 01 00 00 00 00 02 29 2D
									39 01 00 00 00 00 02 2A 00
									39 01 00 00 00 00 02 2B 00
									39 01 00 00 00 00 02 2C 00
									39 01 00 00 00 00 02 2D 00
									39 01 00 00 00 00 02 2E 00
									39 01 00 00 00 00 02 2F 00
									39 01 00 00 00 00 02 30 00
									39 01 00 00 00 00 02 31 00
									39 01 00 00 00 00 02 32 00
									39 01 00 00 00 00 02 33 00
									39 01 00 00 00 00 02 34 00
									39 01 00 00 00 00 02 35 7D
									39 01 00 00 00 00 02 36 00
									39 01 00 00 00 00 02 37 00
									39 01 00 00 00 00 02 38 00
									39 01 00 00 00 00 02 39 00
									39 01 00 00 00 00 02 3A 00
									39 01 00 00 00 00 02 3B 00
									39 01 00 00 00 00 02 3C 00
									39 01 00 00 00 00 02 3D 00
									39 01 00 00 00 00 02 3E 00
									39 01 00 00 00 00 02 3F 00
									39 01 00 00 00 00 02 40 00
									39 01 00 00 00 00 02 41 00
									39 01 00 00 00 00 02 42 00
									39 01 00 00 00 00 02 43 00
									39 01 00 00 00 00 02 44 00
									39 01 00 00 00 00 02 45 00
									39 01 00 00 00 00 02 46 00
									39 01 00 00 00 00 02 47 00
									39 01 00 00 00 00 02 48 00
									39 01 00 00 00 00 02 49 00
									39 01 00 00 00 00 02 4A 00
									39 01 00 00 00 00 02 4B 00
									39 01 00 00 00 00 02 4C 00
									39 01 00 00 00 00 02 4D 00
									39 01 00 00 00 00 02 4E 00
									39 01 00 00 00 00 02 4F 00
									39 01 00 00 00 00 02 50 00
									39 01 00 00 00 00 02 51 00
									39 01 00 00 00 00 02 52 00
									39 01 00 00 00 00 02 53 00
									39 01 00 00 00 00 02 54 00
									39 01 00 00 00 00 02 55 00
									39 01 00 00 00 00 02 56 00
									39 01 00 00 00 00 02 57 00
									39 01 00 00 00 00 02 58 00
									39 01 00 00 00 00 02 59 00
									39 01 00 00 00 00 02 5A 00
									39 01 00 00 00 00 02 5B 00
									39 01 00 00 00 00 02 5C 00
									39 01 00 00 00 00 02 5D 00
									39 01 00 00 00 00 02 5E 00
									39 01 00 00 00 00 02 5F 00
									39 01 00 00 00 00 02 60 00
									39 01 00 00 00 00 02 61 00
									39 01 00 00 00 00 02 62 00
									39 01 00 00 00 00 02 63 00
									39 01 00 00 00 00 02 64 00
									39 01 00 00 00 00 02 65 00
									39 01 00 00 00 00 02 66 00
									39 01 00 00 00 00 02 67 00
									39 01 00 00 00 00 02 68 00
									39 01 00 00 00 00 02 69 00
									39 01 00 00 00 00 02 6A 00
									39 01 00 00 00 00 02 6B 00
									39 01 00 00 00 00 02 6C 00
									39 01 00 00 00 00 02 6D 00
									39 01 00 00 00 00 02 6E 00
									39 01 00 00 00 00 02 6F 00
									39 01 00 00 00 00 02 70 00
									39 01 00 00 00 00 02 71 00
									39 01 00 00 00 00 02 72 00
									39 01 00 00 00 00 02 73 00
									39 01 00 00 00 00 02 74 00
									39 01 00 00 00 00 02 75 00
									39 01 00 00 00 00 02 76 00
									39 01 00 00 00 00 02 77 00
									39 01 00 00 00 00 02 78 00
									39 01 00 00 00 00 02 79 00
									39 01 00 00 00 00 02 7A 00
									39 01 00 00 00 00 02 7B 00
									39 01 00 00 00 00 02 7C 00
									39 01 00 00 00 00 02 7D 00
									39 01 00 00 00 00 02 7E 8B
									39 01 00 00 00 00 02 7F 09
									39 01 00 00 00 00 02 80 0F
									39 01 00 00 00 00 02 81 0D
									39 01 00 00 00 00 02 82 05
									39 01 00 00 00 00 02 83 07
									39 01 00 00 00 00 02 84 3F
									39 01 00 00 00 00 02 85 3F
									39 01 00 00 00 00 02 86 3F
									39 01 00 00 00 00 02 87 3F
									39 01 00 00 00 00 02 88 3F
									39 01 00 00 00 00 02 89 3F
									39 01 00 00 00 00 02 8A 3F
									39 01 00 00 00 00 02 8B 3F
									39 01 00 00 00 00 02 8C 3F
									39 01 00 00 00 00 02 8D 3F
									39 01 00 00 00 00 02 8E 3F
									39 01 00 00 00 00 02 8F 3F
									39 01 00 00 00 00 02 90 3F
									39 01 00 00 00 00 02 91 01
									39 01 00 00 00 00 02 92 1C
									39 01 00 00 00 00 02 93 1D
									39 01 00 00 00 00 02 94 1D
									39 01 00 00 00 00 02 95 1C
									39 01 00 00 00 00 02 96 00
									39 01 00 00 00 00 02 97 3F
									39 01 00 00 00 00 02 98 3F
									39 01 00 00 00 00 02 99 3F
									39 01 00 00 00 00 02 9A 3F
									39 01 00 00 00 00 02 9B 3F
									39 01 00 00 00 00 02 9C 3F
									39 01 00 00 00 00 02 9D 3F
									39 01 00 00 00 00 02 9E 3F
									39 01 00 00 00 00 02 9F 3F
									39 01 00 00 00 00 02 A0 3F
									39 01 00 00 00 00 02 A2 3F
									39 01 00 00 00 00 02 A3 3F
									39 01 00 00 00 00 02 A4 3F
									39 01 00 00 00 00 02 A5 06
									39 01 00 00 00 00 02 A6 04
									39 01 00 00 00 00 02 A7 0C
									39 01 00 00 00 00 02 A9 0E
									39 01 00 00 00 00 02 AA 08
									39 01 00 00 00 00 02 AB 0A
									39 01 00 00 00 00 02 AC 0C
									39 01 00 00 00 00 02 AD 0E
									39 01 00 00 00 00 02 AE 08
									39 01 00 00 00 00 02 AF 0A
									39 01 00 00 00 00 02 B0 06
									39 01 00 00 00 00 02 B1 04
									39 01 00 00 00 00 02 B2 3F
									39 01 00 00 00 00 02 B3 3F
									39 01 00 00 00 00 02 B4 3F
									39 01 00 00 00 00 02 B5 3F
									39 01 00 00 00 00 02 B6 3F
									39 01 00 00 00 00 02 B7 3F
									39 01 00 00 00 00 02 B8 3F
									39 01 00 00 00 00 02 B9 3F
									39 01 00 00 00 00 02 BA 3F
									39 01 00 00 00 00 02 BB 3F
									39 01 00 00 00 00 02 BC 3F
									39 01 00 00 00 00 02 BD 3F
									39 01 00 00 00 00 02 BE 3F
									39 01 00 00 00 00 02 BF 00
									39 01 00 00 00 00 02 C0 1D
									39 01 00 00 00 00 02 C1 1C
									39 01 00 00 00 00 02 C2 1C
									39 01 00 00 00 00 02 C3 1D
									39 01 00 00 00 00 02 C4 01
									39 01 00 00 00 00 02 C5 3F
									39 01 00 00 00 00 02 C6 3F
									39 01 00 00 00 00 02 C7 3F
									39 01 00 00 00 00 02 C8 3F
									39 01 00 00 00 00 02 C9 3F
									39 01 00 00 00 00 02 CA 3F
									39 01 00 00 00 00 02 CB 3F
									39 01 00 00 00 00 02 CC 3F
									39 01 00 00 00 00 02 CD 3F
									39 01 00 00 00 00 02 CE 3F
									39 01 00 00 00 00 02 CF 3F
									39 01 00 00 00 00 02 D0 3F
									39 01 00 00 00 00 02 D1 3F
									39 01 00 00 00 00 02 D2 05
									39 01 00 00 00 00 02 D3 07
									39 01 00 00 00 00 02 D4 0B
									39 01 00 00 00 00 02 D5 09
									39 01 00 00 00 00 02 D6 0F
									39 01 00 00 00 00 02 D7 0D
									39 01 00 00 00 00 02 DC 02
									39 01 00 00 00 00 02 DE 11
									39 01 00 00 00 00 02 FE 0E
									39 01 00 00 00 00 02 01 75
									39 01 00 00 00 00 02 FE 04
									39 01 00 00 00 00 02 60 05
									39 01 00 00 00 00 02 61 13
									39 01 00 00 00 00 02 62 1A
									39 01 00 00 00 00 02 63 0E
									39 01 00 00 00 00 02 64 07
									39 01 00 00 00 00 02 65 13
									39 01 00 00 00 00 02 66 0F
									39 01 00 00 00 00 02 67 0C
									39 01 00 00 00 00 02 68 15
									39 01 00 00 00 00 02 69 0B
									39 01 00 00 00 00 02 6A 0E
									39 01 00 00 00 00 02 6B 07
									39 01 00 00 00 00 02 6C 0E
									39 01 00 00 00 00 02 6D 10
									39 01 00 00 00 00 02 6E 0A
									39 01 00 00 00 00 02 6F 03
									39 01 00 00 00 00 02 70 00
									39 01 00 00 00 00 02 71 13
									39 01 00 00 00 00 02 72 1A
									39 01 00 00 00 00 02 73 0E
									39 01 00 00 00 00 02 74 07
									39 01 00 00 00 00 02 75 13
									39 01 00 00 00 00 02 76 0F
									39 01 00 00 00 00 02 77 0C
									39 01 00 00 00 00 02 78 15
									39 01 00 00 00 00 02 79 0B
									39 01 00 00 00 00 02 7A 0E
									39 01 00 00 00 00 02 7B 07
									39 01 00 00 00 00 02 7C 0E
									39 01 00 00 00 00 02 7D 10
									39 01 00 00 00 00 02 7E 0A
									39 01 00 00 00 00 02 7F 00
									39 01 00 00 00 00 02 FE 00
									39 01 00 00 00 00 02 58 A9
									39 01 00 00 00 00 02 35 00
									39 01 00 00 00 00 02 FE 00
									05 01 00 00 c8 00 02 11 00
									05 01 00 00 28 00 02 29 00];
		qcom,mdss-dsi-off-command = [05 01 00 00 00 00 02 28 00
				05 01 00 00 00 00 02 10 00];
		qcom,mdss-dsi-on-command-state = "dsi_lp_mode";
		qcom,mdss-dsi-off-command-state = "dsi_hs_mode";
		qcom,mdss-dsi-h-sync-pulse = <1>;
		qcom,mdss-dsi-traffic-mode = "burst_mode";
		qcom,mdss-dsi-bllp-eof-power-mode;
		qcom,mdss-dsi-bllp-power-mode;
		qcom,mdss-dsi-lane-0-state;
		qcom,mdss-dsi-lane-1-state;
		qcom,mdss-dsi-lane-2-state;
		qcom,mdss-dsi-lane-3-state;
		qcom,mdss-dsi-panel-timings = [75 18 10 00 3a 3e 14 1a 13 03 04 00];
		qcom,mdss-dsi-t-clk-post = <0x2c>;
		qcom,mdss-dsi-t-clk-pre = <0x20>;
		qcom,mdss-dsi-bl-min-level = <1>;
		qcom,mdss-dsi-bl-max-level = <255>;
		qcom,mdss-dsi-bl-pmic-pwm-frequency = <100>;
		qcom,mdss-dsi-bl-pmic-bank-select = <0>;
		qcom,mdss-dsi-dma-trigger = "trigger_sw";
		qcom,mdss-dsi-mdp-trigger = "none";
		qcom,mdss-dsi-bl-pmic-control-type = "bl_ctrl_pwm";
		qcom,mdss-dsi-reset-sequence = <1 20>, <0 30>, <1 50>;
		qcom,cont-splash-enabled;

	};
};
