/* Create by zougaoxiang@hipad.com  2014/11/04
 * Copyright (c) 2013, The Linux Foundation. All rights reserved.
 *
 * This program is free software; you can redistribute it and/or modify
 * it under the terms of the GNU General Public License version 2 and
 * only version 2 as published by the Free Software Foundation.
 *
 * This program is distributed in the hope that it will be useful,
 * but WITHOUT ANY WARRANTY; without even the implied warranty of
 * MERCHANTABILITY or FITNESS FOR A PARTICULAR PURPOSE.  See the
 * GNU General Public License for more details.
 */

/*---------------------------------------------------------------------------
 * This file is autogenerated file using gcdb parser. Please do not edit it.
 * Update input XML file to add a new entry or update variable in this file
 * VERSION = "1.0"
 *---------------------------------------------------------------------------*/
&mdss_mdp {
	dsi_hx8399a_1080p_video: qcom,mdss_dsi_hx8399a_1080p_video {
		qcom,mdss-dsi-panel-name = "hx8399a 1080p video mode dsi panel";
		qcom,mdss-dsi-panel-controller = <&mdss_dsi0>;
		qcom,mdss-dsi-panel-type = "dsi_video_mode";
		qcom,mdss-dsi-panel-destination = "display_1";
		qcom,mdss-dsi-panel-framerate = <60>;
		qcom,mdss-dsi-virtual-channel-id = <0>;
		qcom,mdss-dsi-stream = <0>;
		qcom,mdss-dsi-panel-width = <1080>;
		qcom,mdss-dsi-panel-height = <1920>;
		qcom,mdss-dsi-h-front-porch = <16>;  
		qcom,mdss-dsi-h-back-porch = <16>;  
		qcom,mdss-dsi-h-pulse-width = <16>;   
		qcom,mdss-dsi-h-sync-skew = <0>;
		qcom,mdss-dsi-v-back-porch = <3>;  
		qcom,mdss-dsi-v-front-porch = <9>; 
		qcom,mdss-dsi-v-pulse-width = <4>;  
		qcom,mdss-dsi-h-left-border = <0>;
		qcom,mdss-dsi-h-right-border = <0>;
		qcom,mdss-dsi-v-top-border = <0>;
		qcom,mdss-dsi-v-bottom-border = <0>;
		qcom,mdss-dsi-bpp = <24>;
		qcom,mdss-dsi-color-order = "rgb_swap_rgb";
		qcom,mdss-dsi-underflow-color = <0xff>;
		qcom,mdss-dsi-border-color = <0>;
		qcom,mdss-dsi-on-command = [
 			39 01 00 00 00 00 04 B9 FF 83 99
 			39 01 00 00 00 00 0D B1 00 74 2E 2E 22 09 22 22 71 F1 59 61
 			39 01 00 00 00 00 0B B2 06 00 00 7F 05 07 23 4D 02 02
 			39 01 00 00 00 00 29 B4 00 FF 08 07 00 02 00 02 05 00 00 01 00 10 01 02 04 31 00 04 44 08 07 00 02 00 02 05 00 00 01 00 10 01 02 04 31 00 04 44
			39 01 00 00 00 00 23 D3 00 02 00 00 00 0E 0E 00 00 03 00 03 00 00 00 00 00 00 00 00 00 00 20 04 04 23 06 06 23 05 08 00 00 4A
 			39 01 00 00 00 00 21 D5 20 20 19 19 18 18 10 11 00 01 00 00 19 19 18 18 00 00 18 18 18 18 18 18 18 18 30 30 31 31 32 32
 			39 01 00 00 00 00 21 D6 20 20 18 18 19 19 01 00 11 10 40 40 19 19 18 18 40 40 18 18 18 18 18 18 18 18 30 30 31 31 32 32
 			39 01 00 00 00 00 31 D8 82 CE 2A AA 82 CE 2A AA 82 CE 2A AA 82 CE 2A AA 00 0E 2A 80 00 0E 2A 80 82 CE 2A AA 82 CE 2A AA 00 00 00 00 00 00 00 00 82 CB 2A BF 82 CB 2A BF
 			39 01 00 00 00 00 03 B6 14 14
 			39 01 00 00 00 00 02 CC 08
 			39 01 00 00 00 00 2B E0 01 0E 12 2B 2F 3F 22 3E 06 0C 10 14 17 15 15 16 1C 09 17 0A 18 01 0E 12 2B 2F 3F 22 3E 06 0C 10 14 17 15 15 16 1C 09 17 0A 18
 			05 01 00 00 00 00 02 29 00
 			05 01 00 00 78 00 02 11 00];
		qcom,mdss-dsi-off-command = [05 01 00 00 32 00 02 28 00
 					05 01 00 00 78 00 02 10 00];
		qcom,mdss-dsi-on-command-state = "dsi_lp_mode";
		qcom,mdss-dsi-off-command-state = "dsi_hs_mode";
		
		qcom,mdss-dsi-panel-status-check-mode = "bta_check";
		qcom,esd-check-enabled;
		
		///qcom,mdss-dsi-hfp-power-mode;
		///qcom,mdss-dsi-hbp-power-mode;//去抖，只加这一条也可以,目前开启会有问题。
		///qcom,mdss-dsi-hsa-power-mode;
		
		qcom,mdss-dsi-h-sync-pulse = <1>;
		qcom,mdss-dsi-traffic-mode = "burst_mode";
		qcom,mdss-dsi-lane-map = "lane_map_0123";
		qcom,mdss-dsi-bllp-eof-power-mode;
		qcom,mdss-dsi-bllp-power-mode;
		qcom,mdss-dsi-lane-0-state;
		qcom,mdss-dsi-lane-1-state;
		qcom,mdss-dsi-lane-2-state;
		qcom,mdss-dsi-lane-3-state;
		qcom,mdss-dsi-panel-timings = [d5 32 22 00 60 64 26 34 29 03 04 00];
		qcom,mdss-dsi-t-clk-post = <0x1f>;
		qcom,mdss-dsi-t-clk-pre = <0x2d>;
		qcom,mdss-dsi-bl-min-level = <1>;
		qcom,mdss-dsi-bl-max-level = <255>; //
		qcom,mdss-dsi-bl-pmic-pwm-frequency = <100>; //
		qcom,mdss-dsi-bl-pmic-bank-select = <0>; //
		qcom,mdss-dsi-dma-trigger = "trigger_sw"; 
		qcom,mdss-dsi-mdp-trigger = "none";
		qcom,mdss-dsi-bl-pmic-control-type = "bl_ctrl_pwm"; //
		qcom,mdss-dsi-reset-sequence = <1 40>, <0 20>, <1 40>;
		qcom,cont-splash-enabled;

	};
};
