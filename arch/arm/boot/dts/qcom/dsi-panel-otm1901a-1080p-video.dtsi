/* Create by zougaoxiang@hipad.com  2014/11/04
 * Copyright (c) 2013, The Linux Foundation. All rights reserved.
 *
 * This program is free software; you can redistribute it and/or modify
 * it under the terms of the GNU General Public License version 2 and
 * only version 2 as published by the Free Software Foundation.
 *
 * This program is distributed in the hope that it will be useful,
 * but WITHOUT ANY WARRANTY; without even the implied warranty of
 * MERCHANTABILITY or FITNESS FOR A PARTICULAR PURPOSE.  See the
 * GNU General Public License for more details.
 */

/*---------------------------------------------------------------------------
 * This file is autogenerated file using gcdb parser. Please do not edit it.
 * Update input XML file to add a new entry or update variable in this file
 * VERSION = "1.0"
 *---------------------------------------------------------------------------*/
&mdss_mdp {
	dsi_otm1901a_1080p_video: qcom,mdss_dsi_otm1901a_1080p_video {
		qcom,mdss-dsi-panel-name = "otm1901a 1080p video mode dsi panel";
		qcom,mdss-dsi-panel-controller = <&mdss_dsi0>;
		qcom,mdss-dsi-panel-type = "dsi_video_mode";
		qcom,mdss-dsi-panel-destination = "display_1";
		qcom,mdss-dsi-panel-framerate = <62>;
		qcom,mdss-dsi-virtual-channel-id = <0>;
		qcom,mdss-dsi-stream = <0>;
		qcom,mdss-dsi-panel-width = <1080>;
		qcom,mdss-dsi-panel-height = <1920>;
		qcom,mdss-dsi-h-front-porch = <24>;  //8
		qcom,mdss-dsi-h-back-porch = <25>;  //12
		qcom,mdss-dsi-h-pulse-width = <20>;   //16
		qcom,mdss-dsi-h-sync-skew = <0>;
		qcom,mdss-dsi-v-back-porch = <8>;  //14
		qcom,mdss-dsi-v-front-porch = <14>;  //9
		qcom,mdss-dsi-v-pulse-width = <2>;  //8
		qcom,mdss-dsi-h-left-border = <0>;
		qcom,mdss-dsi-h-right-border = <0>;
		qcom,mdss-dsi-v-top-border = <0>;
		qcom,mdss-dsi-v-bottom-border = <0>;
		qcom,mdss-dsi-bpp = <24>;
		qcom,mdss-dsi-color-order = "rgb_swap_rgb";
		qcom,mdss-dsi-underflow-color = <0xff>;
		qcom,mdss-dsi-border-color = <0>;
		qcom,mdss-dsi-on-command = [
		
 39 01 00 00 00 00 02 00 00
 39 01 00 00 00 00 04 FF 19 01 01
 
 39 01 00 00 00 00 02 00 80
 39 01 00 00 00 00 03 FF 19 01
 
 39 01 00 00 00 00 02 00 00
 39 01 00 00 00 00 19 e1 00 0f 18 24 2c 34 3f 51 5a 6f 7b 84 74 6e 68 59 46 35 2b 24 1c 12 0f 09
 
 39 01 00 00 00 00 02 00 00
 39 01 00 00 00 00 19 e2 00 0f 18 24 2c 34 3f 51 5a 6f 7b 84 74 6e 68 59 46 35 2b 24 1c 12 0f 09
 
 39 01 00 00 00 00 02 00 00
 39 01 00 00 00 00 19 e3 00 0f 18 24 2c 34 3f 51 5a 6f 7b 84 74 6e 68 59 46 35 2b 24 1c 12 0f 09
 
 39 01 00 00 00 00 02 00 00
 39 01 00 00 00 00 19 e4 00 0f 18 24 2c 34 3f 51 5a 6f 7b 84 74 6e 68 59 46 35 2b 24 1c 12 0f 09
 
 39 01 00 00 00 00 02 00 00
 39 01 00 00 00 00 19 e5 00 0f 18 24 2c 34 3f 51 5a 6f 7b 84 74 6e 68 59 46 35 2b 24 1c 12 0f 09
 
 39 01 00 00 00 00 02 00 00
 39 01 00 00 00 00 19 e6 00 0f 18 24 2c 34 3f 51 5a 6f 7b 84 74 6e 68 59 46 35 2b 24 1c 12 0f 09
 
39 01 00 00 00 00 02 00 90
 39 01 00 00 00 00 02 B0 00
 
 39 01 00 00 00 00 02 00 00
 39 01 00 00 00 00 02 1C 33
 
 
39 01 00 00 00 00 02 00 cd
39 01 00 00 00 00 02 f5 19
 
 
39 01 00 00 00 00 02 00 db
39 01 00 00 00 00 02 f5 19
 
 
39 01 00 00 00 00 02 00 f5
39 01 00 00 00 00 02 c1 40
 
 
39 01 00 00 00 00 02 00 b9
39 01 00 00 00 00 02 c0 11
 
 
39 01 00 00 00 00 02 00 8d
39 01 00 00 00 00 02 f5 20
 
 
39 01 00 00 00 00 02 00 c1
39 01 00 00 00 00 02 f5 15
 
  
39 01 00 00 00 00 02 00 c3
39 01 00 00 00 00 02 f5 15

39 01 00 00 00 00 02 00 BC
39 01 00 00 00 00 02 C0 00
 
39 01 00 00 00 00 02 00 B3
39 01 00 00 00 00 02 C0 CC
 
 39 01 00 00 00 00 02 00 A2
 39 01 00 00 00 00 05 CB FD FD FD FD 

 39 01 00 00 00 00 02 00 00
 39 01 00 00 00 00 02 fb 01
 

 39 01 00 00 00 00 02 00 80
 39 01 00 00 00 00 03 FF 00 00
 
 39 01 00 00 00 00 02 00 00
 39 01 00 00 00 00 04 FF 00 00 00
 		
 
 
 39 01 00 00 00 00 02 51 FF
 
 39 01 00 00 00 00 02 53 24
 
 39 01 00 00 00 00 02 55 00
 
 39 01 00 00 00 00 02 35 01
 
 05 01 00 00 78 00 02 11 00
 		
 05 01 00 00 25 00 02 29 00
 
 39 01 00 00 00 00 02 13 00
 	
 ];
		qcom,mdss-dsi-off-command = [
		
 39 01 00 00 00 00 02 00 00
 39 01 00 00 00 00 04 FF 19 01 01
 
 39 01 00 00 00 00 02 00 80
 39 01 00 00 00 00 03 FF 19 01
 
39 01 00 00 00 00 02 00 00
39 01 00 00 00 00 02 fb 01
  
39 01 00 00 00 00 02 00 BC
39 01 00 00 00 00 02 C0 11
 
39 01 00 00 00 00 02 00 B3
39 01 00 00 00 00 02 C0 DD
 	
 05 01 00 00 32 00 02 22 00
 
 05 01 00 00 32 00 02 28 00
 
 05 01 00 00 78 00 02 10 00
 

 		                             
 		                             ];
 		
		qcom,mdss-dsi-on-command-state = "dsi_lp_mode";
		qcom,mdss-dsi-off-command-state = "dsi_hs_mode";
		
		//qcom,mdss-dsi-panel-status-command = [06 01 00 01 05 00 02 0A 08];
		//qcom,mdss-dsi-panel-status-command-state = "dsi_lp_mode"; // use LPmode to read 
		//qcom,mdss-dsi-panel-status-check-mode = "reg_read"; 
		//qcom,mdss-dsi-panel-status-value = <0x99>; // return value register 
		qcom,mdss-dsi-panel-status-check-mode = "bta_check";
		qcom,esd-check-enabled;
		
		///qcom,mdss-dsi-hfp-power-mode;
		///qcom,mdss-dsi-hbp-power-mode;//去抖，只加这一条也可以。
		///qcom,mdss-dsi-hsa-power-mode;
		
    
		qcom,mdss-dsi-h-sync-pulse = <1>;
		qcom,mdss-dsi-traffic-mode = "burst_mode";
		qcom,mdss-dsi-lane-map = "lane_map_0123";
		qcom,mdss-dsi-bllp-eof-power-mode;
		qcom,mdss-dsi-bllp-power-mode;
		qcom,mdss-dsi-lane-0-state;
		qcom,mdss-dsi-lane-1-state;
		qcom,mdss-dsi-lane-2-state;
		qcom,mdss-dsi-lane-3-state;
		qcom,mdss-dsi-panel-timings = [d5 32 22 00 60 64 26 34 29 03 04 00];
		qcom,mdss-dsi-t-clk-post = <0x1e>;
		qcom,mdss-dsi-t-clk-pre = <0x38>;
		qcom,mdss-dsi-bl-min-level = <1>;
		qcom,mdss-dsi-bl-max-level = <255>; //
		qcom,mdss-dsi-bl-pmic-pwm-frequency = <100>; //
		qcom,mdss-dsi-bl-pmic-bank-select = <0>; //
		qcom,mdss-dsi-dma-trigger = "trigger_sw"; 
		qcom,mdss-dsi-mdp-trigger = "none";
		qcom,mdss-dsi-bl-pmic-control-type = "bl_ctrl_pwm"; //
		qcom,mdss-dsi-reset-sequence = <1 40>, <0 20>, <1 40>;
		qcom,cont-splash-enabled;

	};
};
