/* Copyright (c) 2014, The Linux Foundation. All rights reserved.
 *
 * This program is free software; you can redistribute it and/or modify
 * it under the terms of the GNU General Public License version 2 and
 * only version 2 as published by the Free Software Foundation.
 *
 * This program is distributed in the hope that it will be useful,
 * but WITHOUT ANY WARRANTY; without even the implied warranty of
 * MERCHANTABILITY or FITNESS FOR A PARTICULAR PURPOSE.  See the
 * GNU General Public License for more details.
 */

/*---------------------------------------------------------------------------
 * This file is autogenerated file using gcdb parser. Please do not edit it.
 * Update input XML file to add a new entry or update variable in this file
 * VERSION = "1.0"
 *---------------------------------------------------------------------------*/
&mdss_mdp {
	dsi_hx8394d_720_vid: qcom,mdss_dsi_hx8394d_720p_video {
		qcom,mdss-dsi-panel-name = "hx8394d 720p video mode dsi panel";
		qcom,mdss-dsi-panel-controller = <&mdss_dsi0>;
		qcom,mdss-dsi-panel-type = "dsi_video_mode";
		qcom,mdss-dsi-panel-destination = "display_1";
		qcom,mdss-dsi-panel-framerate = <60>;
		qcom,mdss-dsi-virtual-channel-id = <0>;
		qcom,mdss-dsi-stream = <0>;
		qcom,mdss-dsi-panel-width = <720>;
		qcom,mdss-dsi-panel-height = <1280>;
		qcom,mdss-dsi-h-front-porch = <80>;
		qcom,mdss-dsi-h-back-porch = <45>;
		qcom,mdss-dsi-h-pulse-width = <46>;
		qcom,mdss-dsi-h-sync-skew = <0>;
		qcom,mdss-dsi-v-back-porch = <5>;
		qcom,mdss-dsi-v-front-porch = <9>;
		qcom,mdss-dsi-v-pulse-width = <2>;
		qcom,mdss-dsi-h-left-border = <0>;
		qcom,mdss-dsi-h-right-border = <0>;
		qcom,mdss-dsi-v-top-border = <0>;
		qcom,mdss-dsi-v-bottom-border = <0>;
		qcom,mdss-dsi-bpp = <24>;
		qcom,mdss-dsi-underflow-color = <0xff>;
		qcom,mdss-dsi-border-color = <0>;
		qcom,mdss-dsi-on-command = [39 01 00 00 00 00 04 b9 ff 83 94
				39 01 00 00 00 00 03 ba 33 83
				39 01 00 00 00 00 10 B1 6C 12 12 24 04 11 F1 81 2A 94 23 80 C0 D2 5F
				39 01 00 00 00 00 0c B2 C5 64 05 07 22 1C 08 08 1C 4D 00
				39 01 00 00 00 00 0d B4 00 FF 03 5A 03 5A 03 5A 01 6A 01 6A
				39 01 00 00 00 00 02 BC 07
				39 01 00 00 00 00 04 BF 41 0e 01
				39 01 00 00 00 00 2B E0 1B 22 26 28 2A 31 33 49 06 0B 0D 18 0F 12 14 11 13 06 11 12 19 0D 23 27 28 2A 31 33 48 06 09 0C 17 0D 11 14 12 13 07 10 11 17
				39 01 00 00 00 00 1F D3 00 06 00 01 01 10 00 32 10 00 00 00 32 15 04 35 04 32 15 14 05 14 37 33 00 00 37 00 07 37
				39 01 00 00 00 00 2d D5 18 18 18 18 18 18 18 18 18 18 18 18 18 18 25 24 27 26 18 18 05 04 01 00 07 06 03 02 47 46 43 42 41 40 45 44 21 20 23 22 18 18 18 18
				39 01 00 00 00 00 2d D6 18 18 18 18 18 18 18 18 18 18 18 18 18 18 22 23 20 21 58 58 02 03 06 07 00 01 04 05 00 01 04 05 06 07 02 03 06 07 04 15 18 18 18 18
				39 01 00 00 00 00 02 cc 09
				39 01 00 00 00 00 03 b6 2D 2D
				39 01 00 00 00 00 05 C7 00 C0 40 C0
				05 01 00 00 c8 00 02 11 00
				05 01 00 00 28 00 02 29 00];
		qcom,mdss-dsi-off-command = [05 01 00 00 00 00 02 28 00
				05 01 00 00 00 00 02 10 00];
		qcom,mdss-dsi-on-command-state = "dsi_lp_mode";
		qcom,mdss-dsi-off-command-state = "dsi_hs_mode";
		qcom,mdss-dsi-h-sync-pulse = <1>;
		qcom,mdss-dsi-traffic-mode = "burst_mode";
		qcom,mdss-dsi-bllp-eof-power-mode;
		qcom,mdss-dsi-bllp-power-mode;
		qcom,mdss-dsi-lane-0-state;
		qcom,mdss-dsi-lane-1-state;
		qcom,mdss-dsi-lane-2-state;
		qcom,mdss-dsi-lane-3-state;
		qcom,mdss-dsi-panel-timings = [79 1a 12 00 3e 42 16 1e 15 03 04 00];
		qcom,mdss-dsi-t-clk-post = <0x04>;
		qcom,mdss-dsi-t-clk-pre = <0x1b>;
		qcom,mdss-dsi-bl-min-level = <1>;
		qcom,mdss-dsi-bl-max-level = <255>;
		qcom,mdss-dsi-bl-pmic-pwm-frequency = <100>;
		qcom,mdss-dsi-bl-pmic-bank-select = <0>;
		qcom,mdss-dsi-dma-trigger = "trigger_sw";
		qcom,mdss-dsi-mdp-trigger = "none";
		qcom,mdss-dsi-bl-pmic-control-type = "bl_ctrl_pwm";
		qcom,mdss-dsi-reset-sequence = <1 20>, <0 30>, <1 30>;
		qcom,cont-splash-enabled;

	};
};
